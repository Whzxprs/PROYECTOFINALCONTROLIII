## sdkconfig.defaults
```kconfig
# PISDRSL — configuración ESP-IDF

# Tick de FreeRTOS a 1 kHz → resolución de 1 ms para vTaskDelay
CONFIG_FREERTOS_HZ=1000

# Stack del task principal (app_main)
CONFIG_ESP_MAIN_TASK_STACK_SIZE=8192

# Watchdog de tareas habilitado
CONFIG_ESP_TASK_WDT_EN=y
CONFIG_ESP_TASK_WDT_TIMEOUT_S=5

# Stack del timer ESP (ISR dispatch)
CONFIG_ESP_TIMER_TASK_STACK_SIZE=4096

# Habilitar dispatch de callbacks del esp_timer desde ISR (más preciso que la tarea)
# Sin esto, ESP_TIMER_ISR no existe como opción y el compilador falla.
CONFIG_ESP_TIMER_SUPPORTS_ISR_DISPATCH_METHOD=y

# UART de consola a 115200
CONFIG_ESP_CONSOLE_UART_BAUDRATE=115200

# Nivel de log: INFO en producción
CONFIG_LOG_DEFAULT_LEVEL_INFO=y
```
